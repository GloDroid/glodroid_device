/dts-v1/;
/plugin/;

/{
  fragment_root {
    target-path = "/";
    __overlay__ {
	firmware {
	    android {
		compatible = "android,firmware";

		fstab {
			compatible = "android,fstab";
		};
	    };
	};
    };
  };
};
