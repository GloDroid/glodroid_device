/dts-v1/;
/plugin/;

/ {
    fragment@0 {
        target = <&usb2otg>;
        __overlay__ {
            /* As stated in original dts (sun50i-h6-orangepi-3.dts):
             * ---
             * This board doesn't have a controllable VBUS even though it
             * does have an ID pin. Using it as anything but a USB host is
             * unsafe.
             * ---
             * Android require otg for adb, fastboot and other services.
             * VBUS is connected to board's +5V line, so I do not expect any issues.
             */

            dr_mode = "otg";
        };
    };
};
